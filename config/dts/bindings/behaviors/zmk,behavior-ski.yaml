## config/dts/bindings/behaviors/zmk,behavior-ski.yaml
```yaml
# SPDX-License-Identifier: MIT
description: Sticky Key Infinite

compatible: "zmk,behavior-ski"

#binding-cells:
#  - keycode

include: one_param.yaml

properties:
  label:
    type: string
#    required: true
    description: Sticky Key Infinite behavior binding
```
